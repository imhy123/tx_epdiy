## main/Kconfig.projbuild
```kconfig
menu "Photo Frame Configuration"

    choice EPDIY_DISPLAY
        prompt "E-paper display model"
        default EPDIY_DISPLAY_ES108FC2
        help
            Select the e-paper panel connected to the epdiy board.
            The choice maps to an EpdDisplay_t definition in epdiy_main.c
            (resolution, bus width/speed and default waveform).

        config EPDIY_DISPLAY_ES108FC2
            bool "ES108FC2 — 1920x1080, 16-bit (project default)"

        config EPDIY_DISPLAY_ES108FC
            bool "ES108FC — 1920x1080"

        config EPDIY_DISPLAY_ES080FC
            bool "ES080FC — 1800x600, 16-bit"

        config EPDIY_DISPLAY_ES120
            bool "ES120 — 2560x1600, 16-bit"

        config EPDIY_DISPLAY_ED060KD1
            bool "ED060KD1 — 1448x1072, 8-bit"

        config EPDIY_DISPLAY_EC080SC2
            bool "EC080SC2 — 1800x800, 16-bit"
    endchoice

endmenu
```

## sdkconfig.defaults.esp32s3
```kconfig
# ESP32-S3 specific defaults.

# --- Flash: 16 MB ---
CONFIG_ESPTOOLPY_FLASHSIZE_16MB=y
CONFIG_ESPTOOLPY_FLASHSIZE="16MB"

# --- Custom partition table: large factory app + photo storage ---
CONFIG_PARTITION_TABLE_CUSTOM=y
CONFIG_PARTITION_TABLE_CUSTOM_FILENAME="partitions/esp32s3_n16r8.csv"

# --- Octal PSRAM (e.g. N16R8 = 8 MB), required for the epdiy framebuffer ---
CONFIG_SPIRAM=y
CONFIG_SPIRAM_MODE_OCT=y
CONFIG_SPIRAM_SPEED_80M=y

# --- Data cache: 64 KB with a 64-byte line — required by epdiy's parallel LCD
#     DMA. A 32-byte line makes epdiy drop the pixel clock and causes
#     "line buffer underrun" / "draw error: 400" (screen never refreshes). ---
CONFIG_ESP32S3_DATA_CACHE_64KB=y
CONFIG_ESP32S3_DATA_CACHE_LINE_64B=y
```
